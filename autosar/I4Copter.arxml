AUTOSAR XML (schema 4-3-0)
package /ActiveEcuC
  module config EcuC: implementation-config-variant=VARIANT-PRE-COMPILE, module-description=EcuC_Impl
    EcucGeneral:
      DummyFunction = false
      DummyStatement = true
      StructAlignment = Auto
      ArrayAlignment = Align8Bit
      StructInArrayAlignment = Auto
      SizeOfEnum = Size8Bit
      SizeOfROMPointer = Size32Bit
      SizeOfRAMPointer = Size32Bit
      CPUType = CPU32Bit
      SizeOfInt = Size32Bit
      ByteOrder = LITTLE_ENDIAN
      BitOrder = LSB_to_MSB
      AtomicBitAccessInBitfield = true
      AtomicVariableAccess = Atomic32BitAccess
      BitFieldDataType = INT
      EcuCSafeBswChecks = false
      DummyStatementKind = None
      ConditionalGenerating = true
      EcucBswImplementationCodeType = EcuCSourceCode
      EcuCUseStdReturnTypeForRte = false
      PostbuildLoadable: AlignmentFillPattern=90, PBROMStartAddress=0, PBRAMStartAddress=0, PBROMEndAddress=0, PBRAMEndAddress=0
    EcucHardware
      3 x EcucCoreDefinition:
        EcucCoreDefinition_{0..2}: EcucCoreId={0..2}
  module config Os: implementation-config-variant=VARIANT-PRE-COMPILE, module-description=Os_Impl
    SystemTimer_0 (OsCounter):
      OsCounterMaxAllowedValue = 2147483647
      OsCounterMinCycle = 1
      OsCounterType = HARDWARE
      OsSecondsPerTick = 0.001
      OsCounterTicksPerBase = 1
      OsCounterAccessingApplication = SystemApplication_OsCore_Core{0..2}
      OsDriver: OsDriverHighResolution=false, OsDriverHardwareTimerChannelRef=GPT_Ch0, OsDriverIsrRef=CounterIsr_SystemTimer_0
    OsOS:
      OsStackMonitoring = true
      OsStatus = EXTENDED
      OsUseGetServiceId = false
      OsUseParameterAccess = false
      OsUseResScheduler = false
      OsForcibleTermination = false
      OsGenerateCalloutStubs = true
      OsGenerateMemMap = COMPLETE
      OsGenerateMemMapForNearAddressing = true
      OsGenerateMemMapForThreads = false
      OsServiceProtection = false
      OsStackUsageMeasurement = false
      OsUseXSignalAsyncApiCalls = false
      OsNumberOfCores = 3
      OsScalabilityClass = SC3
      OsSystemTimer = SystemTimer_0
      OsMasterCore = OsCore_Core0
      OsHooks: OsErrorHook=true, OsPostTaskHook=false, OsPreTaskHook=false, OsShutdownHook=false, OsStartupHook=false
    OsMemoryProtection
      21 x OsMemoryRegion:
        EXC_ALL_Core{0..2}: OsMemoryRegionStartAddress=0, OsMemoryRegionEndAddress=0xFFFFFFFF, OsMemoryRegionProtectionUnit=OsPhysicalCore{0..2}CodeMpu, OsMemoryRegionAccessRights=PS0_X, OsMemoryRegionAccessRights=PS1_X, OsMemoryRegionAccessRights=PS2_X, OsMemoryRegionAccessRights=PS3_X
        READ_ALL_Core{0..2}: OsMemoryRegionStartAddress=0, OsMemoryRegionEndAddress=0xFFFFFFFF, OsMemoryRegionProtectionUnit=OsPhysicalCore{0..2}DataMpu, OsMemoryRegionAccessRights=PS0_R, OsMemoryRegionAccessRights=PS1_R, OsMemoryRegionAccessRights=PS2_R, OsMemoryRegionAccessRights=PS3_R
        TRUSTED_WRITE_SPR_Core0: OsMemoryRegionEndAddress=0x7FFFFFFF, OsMemoryRegionStartAddress=_OS_CORE0_STACKS_END, OsMemoryRegionProtectionUnit=OsPhysicalCore0DataMpu, OsMemoryRegionAccessRights=PS0_W
        TRUSTED_WRITE_SPR_Core1: OsMemoryRegionEndAddress=0x6FFFFFFF, OsMemoryRegionStartAddress=_OS_CORE1_STACKS_END, OsMemoryRegionProtectionUnit=OsPhysicalCore1DataMpu, OsMemoryRegionAccessRights=PS0_W
        TRUSTED_WRITE_SPR_Core2: OsMemoryRegionEndAddress=0x5FFFFFFF, OsMemoryRegionStartAddress=_OS_CORE2_STACKS_END, OsMemoryRegionProtectionUnit=OsPhysicalCore2DataMpu, OsMemoryRegionAccessRights=PS0_W
        TRUSTED_WRITE_ALL_Core{0..2}: OsMemoryRegionStartAddress=0x80000000, OsMemoryRegionEndAddress=0xFFFFFFFF, OsMemoryRegionProtectionUnit=OsPhysicalCore{0..2}DataMpu, OsMemoryRegionAccessRights=PS0_W
        MemoryRegion_App_SystemApplication_OsCore_Core0: OsMemoryRegionStartAddress=_OS_SystemApplication_OsCore_Core0_VAR_ALL_START, OsMemoryRegionEndAddress=_OS_SystemApplication_OsCore_Core0_VAR_ALL_END, OsMemoryRegionIdentifier=0, OsMemoryRegionProtectionUnit=OsPhysicalCore0DataMpu, OsMemoryRegionAccessRights=PS0_W, OsMemoryRegionOwner=SystemApplication_OsCore_Core0
        MemoryRegion_App_OS_App0_Core0: OsMemoryRegionStartAddress=_OS_OS_App0_Core0_VAR_ALL_START, OsMemoryRegionEndAddress=_OS_OS_App0_Core0_VAR_ALL_END, OsMemoryRegionIdentifier=0, OsMemoryRegionProtectionUnit=OsPhysicalCore0DataMpu, OsMemoryRegionAccessRights=PS0_W, OsMemoryRegionOwner=OS_App0_Core0
        MemoryRegion_App_SystemApplication_OsCore_Core1: OsMemoryRegionStartAddress=_OS_SystemApplication_OsCore_Core1_VAR_ALL_START, OsMemoryRegionEndAddress=_OS_SystemApplication_OsCore_Core1_VAR_ALL_END, OsMemoryRegionIdentifier=1, OsMemoryRegionProtectionUnit=OsPhysicalCore1DataMpu, OsMemoryRegionAccessRights=PS1_W, OsMemoryRegionOwner=SystemApplication_OsCore_Core1
        MemoryRegion_App_OS_App0_Core1: OsMemoryRegionStartAddress=_OS_OS_App0_Core1_VAR_ALL_START, OsMemoryRegionEndAddress=_OS_OS_App0_Core1_VAR_ALL_END, OsMemoryRegionIdentifier=1, OsMemoryRegionProtectionUnit=OsPhysicalCore1DataMpu, OsMemoryRegionAccessRights=PS1_W, OsMemoryRegionOwner=OS_App0_Core1
        MemoryRegion_App_SystemApplication_OsCore_Core2: OsMemoryRegionStartAddress=_OS_SystemApplication_OsCore_Core2_VAR_ALL_START, OsMemoryRegionEndAddress=_OS_SystemApplication_OsCore_Core2_VAR_ALL_END, OsMemoryRegionIdentifier=2, OsMemoryRegionProtectionUnit=OsPhysicalCore2DataMpu, OsMemoryRegionAccessRights=PS2_W, OsMemoryRegionOwner=SystemApplication_OsCore_Core2
        MemoryRegion_App_OS_App0_Core2: OsMemoryRegionStartAddress=_OS_OS_App0_Core2_VAR_ALL_START, OsMemoryRegionEndAddress=_OS_OS_App0_Core2_VAR_ALL_END, OsMemoryRegionIdentifier=2, OsMemoryRegionProtectionUnit=OsPhysicalCore2DataMpu, OsMemoryRegionAccessRights=PS2_W, OsMemoryRegionOwner=OS_App0_Core2
        MemoryRegion_App_OS_App1_Core{0..2}: OsMemoryRegionStartAddress=_OS_OS_App1_Core{0..2}_VAR_ALL_START, OsMemoryRegionEndAddress=_OS_OS_App1_Core{0..2}_VAR_ALL_END, OsMemoryRegionIdentifier={0..2}, OsMemoryRegionProtectionUnit=OsPhysicalCore{0..2}DataMpu, OsMemoryRegionAccessRights=PS{0..2}_W, OsMemoryRegionOwner=OS_App1_Core{0..2}
    OSDEFAULTAPPMODE (OsAppMode)
    OS_APPMODE_ANY (OsAppMode)
    OsPublishedInformation: OsKernelVersion=7, OsPlatformName=TriCoreAurix
      TC27x (OsDerivativeInformation):
        OsMpuAlignment = 8
        OsStackAlignment = 8
        OsExceptionVectorTableAlignment = 32
        OsInterruptVectorTableAlignment = 32
        OsHardwareManuals = User Manual: tc27xD_um_v2.2_UserManual_rev2v2_2014-12.pdf V2.2 Errata Sheet: TC27x_BC_Errata_Sheet_rev1v5_2015_09_16.pdf V1.5 Safety Manual: AURIX Safety Manual_3.pdf V1.3 2015-09
        3 x OsPhysicalCore, all with OsPhysicalCoreExceptionSources=8, OsPhysicalCorePrivelegedHwAccess=true:
          Core0: OsPhysicalCoreId=0, OsPhysicalCoreDefaultEntrySymbol=_start_tc0, OsPhysicalCoreType=TC1.6.1E, OsPhysicalCoreMasterStartAllowed=true, OsPhysicalCoreIsAutostart=true, OsPhysicalCoreStackProtectionUnit=OsPhysicalCore0DataMpu
            OsPhysicalCore0DataMpu (OsPhysicalCoreMpu): OsPhysicalCoreMpuId=0, OsPhysicalCoreMpuMaxRegions=15, OsPhysicalCoreMpuType=DATA
            OsPhysicalCore0CodeMpu (OsPhysicalCoreMpu): OsPhysicalCoreMpuId=1, OsPhysicalCoreMpuMaxRegions=8, OsPhysicalCoreMpuType=CODE
          Core1: OsPhysicalCoreId=1, OsPhysicalCoreDefaultEntrySymbol=_start_tc1, OsPhysicalCoreType=TC1.6.1P, OsPhysicalCoreMasterStartAllowed=false, OsPhysicalCoreIsAutostart=false, OsPhysicalCoreStackProtectionUnit=OsPhysicalCore1DataMpu
            OsPhysicalCore1DataMpu (OsPhysicalCoreMpu): OsPhysicalCoreMpuId=0, OsPhysicalCoreMpuMaxRegions=15, OsPhysicalCoreMpuType=DATA
            OsPhysicalCore1CodeMpu (OsPhysicalCoreMpu): OsPhysicalCoreMpuId=1, OsPhysicalCoreMpuMaxRegions=8, OsPhysicalCoreMpuType=CODE
          Core2: OsPhysicalCoreId=2, OsPhysicalCoreDefaultEntrySymbol=_start_tc2, OsPhysicalCoreType=TC1.6.1P, OsPhysicalCoreMasterStartAllowed=false, OsPhysicalCoreIsAutostart=false, OsPhysicalCoreStackProtectionUnit=OsPhysicalCore2DataMpu
            OsPhysicalCore2DataMpu (OsPhysicalCoreMpu): OsPhysicalCoreMpuId=0, OsPhysicalCoreMpuMaxRegions=15, OsPhysicalCoreMpuType=DATA
            OsPhysicalCore2CodeMpu (OsPhysicalCoreMpu): OsPhysicalCoreMpuId=1, OsPhysicalCoreMpuMaxRegions=8, OsPhysicalCoreMpuType=CODE
        3 x OsHardwareTimer, all with OsHardwareTimerSize=32, OsHardwareTimerUnit=FRT, OsHardwareTimerType=STM:
          STM0: OsHardwareTimerBaseAddress=4026531840, OsHardwareTimerId=0
            STM0_Ch0 (OsHardwareTimerChannel): OsHardwareTimerChannelIntSource=1168, OsHardwareTimerChannelOffset=0, OsHardwareTimerChannelId=0
            STM0_Ch1 (OsHardwareTimerChannel): OsHardwareTimerChannelIntSource=1172, OsHardwareTimerChannelOffset=1, OsHardwareTimerChannelId=1
          STM1: OsHardwareTimerBaseAddress=4026532096, OsHardwareTimerId=1
            STM1_Ch0 (OsHardwareTimerChannel): OsHardwareTimerChannelIntSource=1176, OsHardwareTimerChannelOffset=0, OsHardwareTimerChannelId=0
            STM1_Ch1 (OsHardwareTimerChannel): OsHardwareTimerChannelIntSource=1180, OsHardwareTimerChannelOffset=1, OsHardwareTimerChannelId=1
          STM2: OsHardwareTimerBaseAddress=4026532352, OsHardwareTimerId=2
            STM2_Ch0 (OsHardwareTimerChannel): OsHardwareTimerChannelIntSource=1184, OsHardwareTimerChannelOffset=0, OsHardwareTimerChannelId=0
            STM2_Ch1 (OsHardwareTimerChannel): OsHardwareTimerChannelIntSource=1188, OsHardwareTimerChannelOffset=1, OsHardwareTimerChannelId=1
        AURIXTC2XX_IR (OsSystemIntCtrl): OsSystemIntCtrlMaxPrios=255, OsSystemIntCtrlPrioOrder=ASC, OsSystemIntCtrlMaxSources=8192, OsSystemIntCtrlBaseAddress=4026757120
        GPT (OsHardwareTimer): OsHardwareTimerSize=16, OsHardwareTimerUnit=PIT, OsHardwareTimerBaseAddress=4026543616, OsHardwareTimerId=0, OsHardwareTimerType=PIT
          GPT_Ch0 (OsHardwareTimerChannel): OsHardwareTimerChannelIntSource=1128, OsHardwareTimerChannelOffset=0, OsHardwareTimerChannelId=0
          GPT_Ch1 (OsHardwareTimerChannel): OsHardwareTimerChannelIntSource=1140, OsHardwareTimerChannelOffset=1, OsHardwareTimerChannelId=1
        OsMemoryRegionSpecifics
          12 x OsMemoryRegionAccess:
            PS0_R: OsMemoryRegionAccessRights=R, OsMemoryRegionAccessType=PROTECTION_SET0
            PS0_W: OsMemoryRegionAccessRights=W, OsMemoryRegionAccessType=PROTECTION_SET0
            PS0_X: OsMemoryRegionAccessRights=X, OsMemoryRegionAccessType=PROTECTION_SET0
            PS1_R: OsMemoryRegionAccessRights=R, OsMemoryRegionAccessType=PROTECTION_SET1
            PS1_W: OsMemoryRegionAccessRights=W, OsMemoryRegionAccessType=PROTECTION_SET1
            PS1_X: OsMemoryRegionAccessRights=X, OsMemoryRegionAccessType=PROTECTION_SET1
            PS2_R: OsMemoryRegionAccessRights=R, OsMemoryRegionAccessType=PROTECTION_SET2
            PS2_W: OsMemoryRegionAccessRights=W, OsMemoryRegionAccessType=PROTECTION_SET2
            PS2_X: OsMemoryRegionAccessRights=X, OsMemoryRegionAccessType=PROTECTION_SET2
            PS3_R: OsMemoryRegionAccessRights=R, OsMemoryRegionAccessType=PROTECTION_SET3
            PS3_W: OsMemoryRegionAccessRights=W, OsMemoryRegionAccessType=PROTECTION_SET3
            PS3_X: OsMemoryRegionAccessRights=X, OsMemoryRegionAccessType=PROTECTION_SET3
        OsMemoryRegionDefault_AppT (OsMemoryRegionDefaults): OsMemoryRegionDefType=APPLICATION_TRUSTED, OsMemoryRegionDefIdentifier=0, OsMemoryRegionDefAccessRights=PS0_W
        OsMemoryRegionDefault_AppNT (OsMemoryRegionDefaults): OsMemoryRegionDefType=APPLICATION_NONTRUSTED, OsMemoryRegionDefIdentifier=1, OsMemoryRegionDefAccessRights=PS1_W
    OsCore_Core0 (OsCore):
      OsCoreIsAutostart = true
      OsCoreIsAutosar = true
      OsCoreEntrySymbol = _start_tc0
      OsCorePhysicalCoreRef = Core0
      OsCoreIdleTask = IdleTask_OsCore_Core0
      OsCoreSystemApplication = SystemApplication_OsCore_Core0
      OsCoreEcucCoreRef = EcucCoreDefinition_0
      OsCoreStacks:
        OsCoreKernelStackSize = 1024
        OsCoreStartupStackSize = 1024
        OsCoreShutdownStackSize = 1024
        OsCoreErrorStackSize = 1024
        OsCoreProtectionStackSize = 1024
        OsCoreInitStackSize = 1024
      XSignalChl_OsCore_Core2 (OsCoreXSignalChannel): OsCoreXSignalChannelSize=1, OsCoreXSignalChannelReceiverIsr=XSignalIsr_OsCore_Core2
      XSignalChl_OsCore_Core1 (OsCoreXSignalChannel): OsCoreXSignalChannelSize=1, OsCoreXSignalChannelReceiverIsr=XSignalIsr_OsCore_Core1
    SystemApplication_OsCore_Core0 (OsApplication):
      OsTrusted = true
      OsTrustedApplicationDelayTimingViolationCall = false
      OsTrustedApplicationWithProtection = false
      OsApplicationIsPrivileged = true
      OsAppUseTrustedFunctionStubs = false
      OsAppMemoryProtectionIdentifier = 0
      OsApplicationCoreRef = EcucCoreDefinition_0
      OsAppCounterRef = SystemTimer_0
      OsAppIsrRef = CounterIsr_SystemTimer_0
      OsAppIsrRef = XSignalIsr_OsCore_Core0
      OsAppTaskRef = IdleTask_OsCore_Core0
      OsAppCounterRef = Timer_3ms_Core0
      OsApplicationHooks: OsAppErrorHook=false, OsAppShutdownHook=false, OsAppStartupHook=false
    OsCore_Core1 (OsCore):
      OsCoreIsAutostart = true
      OsCoreIsAutosar = true
      OsCoreEntrySymbol = _start_tc1
      OsCorePhysicalCoreRef = Core1
      OsCoreSystemApplication = SystemApplication_OsCore_Core1
      OsCoreEcucCoreRef = EcucCoreDefinition_1
      OsCoreIdleTask = IdleTask_OsCore_Core1
      OsCoreStacks:
        OsCoreKernelStackSize = 1024
        OsCoreStartupStackSize = 1024
        OsCoreShutdownStackSize = 1024
        OsCoreErrorStackSize = 1024
        OsCoreProtectionStackSize = 1024
        OsCoreInitStackSize = 1024
      XSignalChl_OsCore_Core2 (OsCoreXSignalChannel): OsCoreXSignalChannelSize=1, OsCoreXSignalChannelReceiverIsr=XSignalIsr_OsCore_Core2
      XSignalChl_OsCore_Core0 (OsCoreXSignalChannel): OsCoreXSignalChannelSize=1, OsCoreXSignalChannelReceiverIsr=XSignalIsr_OsCore_Core0
    OsCore_Core2 (OsCore):
      OsCoreIsAutostart = true
      OsCoreIsAutosar = true
      OsCoreEntrySymbol = _start_tc2
      OsCorePhysicalCoreRef = Core2
      OsCoreIdleTask = IdleTask_OsCore_Core2
      OsCoreSystemApplication = SystemApplication_OsCore_Core2
      OsCoreEcucCoreRef = EcucCoreDefinition_2
      OsCoreStacks:
        OsCoreKernelStackSize = 1024
        OsCoreStartupStackSize = 1024
        OsCoreShutdownStackSize = 1024
        OsCoreErrorStackSize = 1024
        OsCoreProtectionStackSize = 1024
        OsCoreInitStackSize = 1024
      XSignalChl_OsCore_Core0 (OsCoreXSignalChannel): OsCoreXSignalChannelSize=1, OsCoreXSignalChannelReceiverIsr=XSignalIsr_OsCore_Core0
      XSignalChl_OsCore_Core1 (OsCoreXSignalChannel): OsCoreXSignalChannelSize=1, OsCoreXSignalChannelReceiverIsr=XSignalIsr_OsCore_Core1
    SystemApplication_OsCore_Core1 (OsApplication):
      OsTrusted = true
      OsTrustedApplicationDelayTimingViolationCall = false
      OsTrustedApplicationWithProtection = false
      OsApplicationIsPrivileged = true
      OsAppUseTrustedFunctionStubs = false
      OsAppMemoryProtectionIdentifier = 1
      OsApplicationCoreRef = EcucCoreDefinition_1
      OsAppTaskRef = IdleTask_OsCore_Core1
      OsAppIsrRef = XSignalIsr_OsCore_Core1
      OsAppIsrRef = CounterIsr_SystemTimer_1
      OsAppCounterRef = SystemTimer_1
      OsApplicationHooks: OsAppErrorHook=false, OsAppShutdownHook=false, OsAppStartupHook=false
    SystemApplication_OsCore_Core2 (OsApplication):
      OsTrusted = true
      OsTrustedApplicationDelayTimingViolationCall = false
      OsTrustedApplicationWithProtection = false
      OsApplicationIsPrivileged = true
      OsAppUseTrustedFunctionStubs = false
      OsAppMemoryProtectionIdentifier = 2
      OsAppTaskRef = IdleTask_OsCore_Core2
      OsApplicationCoreRef = EcucCoreDefinition_2
      OsAppIsrRef = XSignalIsr_OsCore_Core2
      OsAppIsrRef = CounterIsr_SystemTimer_2
      OsApplicationHooks: OsAppErrorHook=false, OsAppShutdownHook=false, OsAppStartupHook=false
    IdleTask_OsCore_Core2 (OsTask):
      OsTaskActivation = 1
      OsTaskPriority = -1
      OsTaskSchedule = FULL
      OsTaskStackSharing = false
      OsTaskStackSize = 1024
      OsTaskType = AUTO
      OsTaskAccessingApplication = SystemApplication_OsCore_Core{0..2}
      OsTaskAutostart: OsTaskAppModeRef=OS_APPMODE_ANY
    3 x OsIsr, all with OsIsrCategory=CATEGORY_2, OsIsrInterruptType=EXTERNAL, OsIsrStackSize=1024, OsIsrEnableNesting=false:
      XSignalIsr_OsCore_Core2: OsIsrInterruptSource=1, OsIsrInterruptPriority=255, OsIsrSpecialFunctionName=Os_XSigRecvIsrHandler
        OsIsrXSignalReceiver:
          OsIsrXSignalReceiverProvidedApis = ShutdownAllCores
          OsIsrXSignalReceiverProvidedApis = ActivateTask
          OsIsrXSignalReceiverProvidedApis = CancelAlarm
          OsIsrXSignalReceiverProvidedApis = ChainTask
          OsIsrXSignalReceiverProvidedApis = ControlIdle
          OsIsrXSignalReceiverProvidedApis = GetAlarm
          OsIsrXSignalReceiverProvidedApis = GetApplicationState
          OsIsrXSignalReceiverProvidedApis = GetCounterValue
          OsIsrXSignalReceiverProvidedApis = GetElapsedValue
          OsIsrXSignalReceiverProvidedApis = GetErrorHookStackUsage
          OsIsrXSignalReceiverProvidedApis = GetEvent
          OsIsrXSignalReceiverProvidedApis = GetISRStackUsage
          OsIsrXSignalReceiverProvidedApis = GetKernelStackUsage
          OsIsrXSignalReceiverProvidedApis = GetProtectionHookStackUsage
          OsIsrXSignalReceiverProvidedApis = GetScheduleTableStatus
          OsIsrXSignalReceiverProvidedApis = GetShutdownHookStackUsage
          OsIsrXSignalReceiverProvidedApis = GetStartupHookStackUsage
          OsIsrXSignalReceiverProvidedApis = GetTaskStackUsage
          OsIsrXSignalReceiverProvidedApis = GetTaskState
          OsIsrXSignalReceiverProvidedApis = HookCallCallback
          OsIsrXSignalReceiverProvidedApis = NextScheduleTable
          OsIsrXSignalReceiverProvidedApis = SetAbsAlarm
          OsIsrXSignalReceiverProvidedApis = SetEvent
          OsIsrXSignalReceiverProvidedApis = SetRelAlarm
          OsIsrXSignalReceiverProvidedApis = StartScheduleTableAbs
          OsIsrXSignalReceiverProvidedApis = StartScheduleTableRel
          OsIsrXSignalReceiverProvidedApis = StopScheduleTable
          OsIsrXSignalReceiverProvidedApis = TerminateApplication
      CounterIsr_SystemTimer_0: OsIsrInterruptSource=1128, OsIsrInterruptPriority=1, OsIsrSpecialFunctionName=Os_TimerPitIsr
      XSignalIsr_OsCore_Core0: OsIsrInterruptSource=1, OsIsrInterruptPriority=255, OsIsrSpecialFunctionName=Os_XSigRecvIsrHandler
        OsIsrXSignalReceiver:
          OsIsrXSignalReceiverProvidedApis = ShutdownAllCores
          OsIsrXSignalReceiverProvidedApis = ActivateTask
          OsIsrXSignalReceiverProvidedApis = CancelAlarm
          OsIsrXSignalReceiverProvidedApis = ChainTask
          OsIsrXSignalReceiverProvidedApis = ControlIdle
          OsIsrXSignalReceiverProvidedApis = GetAlarm
          OsIsrXSignalReceiverProvidedApis = GetApplicationState
          OsIsrXSignalReceiverProvidedApis = GetCounterValue
          OsIsrXSignalReceiverProvidedApis = GetElapsedValue
          OsIsrXSignalReceiverProvidedApis = GetErrorHookStackUsage
          OsIsrXSignalReceiverProvidedApis = GetEvent
          OsIsrXSignalReceiverProvidedApis = GetISRStackUsage
          OsIsrXSignalReceiverProvidedApis = GetKernelStackUsage
          OsIsrXSignalReceiverProvidedApis = GetProtectionHookStackUsage
          OsIsrXSignalReceiverProvidedApis = GetScheduleTableStatus
          OsIsrXSignalReceiverProvidedApis = GetShutdownHookStackUsage
          OsIsrXSignalReceiverProvidedApis = GetStartupHookStackUsage
          OsIsrXSignalReceiverProvidedApis = GetTaskStackUsage
          OsIsrXSignalReceiverProvidedApis = GetTaskState
          OsIsrXSignalReceiverProvidedApis = HookCallCallback
          OsIsrXSignalReceiverProvidedApis = NextScheduleTable
          OsIsrXSignalReceiverProvidedApis = SetAbsAlarm
          OsIsrXSignalReceiverProvidedApis = SetEvent
          OsIsrXSignalReceiverProvidedApis = SetRelAlarm
          OsIsrXSignalReceiverProvidedApis = StartScheduleTableAbs
          OsIsrXSignalReceiverProvidedApis = StartScheduleTableRel
          OsIsrXSignalReceiverProvidedApis = StopScheduleTable
          OsIsrXSignalReceiverProvidedApis = TerminateApplication
    OS_App0_Core1 (OsApplication):
      OsTrusted = true
      OsTrustedApplicationDelayTimingViolationCall = false
      OsTrustedApplicationWithProtection = false
      OsApplicationIsPrivileged = false
      OsAppUseTrustedFunctionStubs = false
      OsAppMemoryProtectionIdentifier = 1
      OsApplicationCoreRef = EcucCoreDefinition_1
      OsAppCounterRef = Timer_3ms_Core1
      OsAppTaskRef = T2_EngineController
      OsAppAlarmRef = T2_periodic_9ms
      OsAppCounterRef = Timer_9ms_Core1
      OsApplicationHooks: OsAppErrorHook=false, OsAppShutdownHook=false, OsAppStartupHook=false
    OS_App0_Core0 (OsApplication):
      OsTrusted = true
      OsTrustedApplicationDelayTimingViolationCall = false
      OsTrustedApplicationWithProtection = false
      OsApplicationIsPrivileged = false
      OsAppUseTrustedFunctionStubs = false
      OsAppMemoryProtectionIdentifier = 0
      OsApplicationCoreRef = EcucCoreDefinition_1
      OsAppTaskRef = T1_Controllers
      OsAppAlarmRef = T1_periodic_9ms
      OsAppCounterRef = Timer_9ms_Core0
      OsApplicationHooks: OsAppErrorHook=false, OsAppShutdownHook=false, OsAppStartupHook=false
    IdleTask_OsCore_Core0 (OsTask):
      OsTaskActivation = 1
      OsTaskPriority = -1
      OsTaskSchedule = FULL
      OsTaskStackSharing = false
      OsTaskStackSize = 1024
      OsTaskType = AUTO
      OsTaskAccessingApplication = SystemApplication_OsCore_Core1
      OsTaskAccessingApplication = SystemApplication_OsCore_Core2
      OsTaskAccessingApplication = SystemApplication_OsCore_Core0
      OsTaskAutostart: OsTaskAppModeRef=OS_APPMODE_ANY
    IdleTask_OsCore_Core1 (OsTask):
      OsTaskActivation = 1
      OsTaskPriority = -1
      OsTaskSchedule = FULL
      OsTaskStackSharing = false
      OsTaskStackSize = 1024
      OsTaskType = AUTO
      OsTaskAccessingApplication = SystemApplication_OsCore_Core1
      OsTaskAccessingApplication = SystemApplication_OsCore_Core0
      OsTaskAccessingApplication = SystemApplication_OsCore_Core2
      OsTaskAutostart: OsTaskAppModeRef=OS_APPMODE_ANY
    XSignalIsr_OsCore_Core1 (OsIsr):
      OsIsrCategory = CATEGORY_2
      OsIsrInterruptType = EXTERNAL
      OsIsrInterruptSource = 1
      OsIsrInterruptPriority = 0
      OsIsrStackSize = 1024
      OsIsrEnableNesting = false
      OsIsrSpecialFunctionName = Os_XSigRecvIsrHandler
      OsIsrXSignalReceiver:
        OsIsrXSignalReceiverProvidedApis = ShutdownAllCores
        OsIsrXSignalReceiverProvidedApis = ActivateTask
        OsIsrXSignalReceiverProvidedApis = CancelAlarm
        OsIsrXSignalReceiverProvidedApis = ChainTask
        OsIsrXSignalReceiverProvidedApis = ControlIdle
        OsIsrXSignalReceiverProvidedApis = GetAlarm
        OsIsrXSignalReceiverProvidedApis = GetApplicationState
        OsIsrXSignalReceiverProvidedApis = GetCounterValue
        OsIsrXSignalReceiverProvidedApis = GetElapsedValue
        OsIsrXSignalReceiverProvidedApis = GetErrorHookStackUsage
        OsIsrXSignalReceiverProvidedApis = GetEvent
        OsIsrXSignalReceiverProvidedApis = GetISRStackUsage
        OsIsrXSignalReceiverProvidedApis = GetKernelStackUsage
        OsIsrXSignalReceiverProvidedApis = GetProtectionHookStackUsage
        OsIsrXSignalReceiverProvidedApis = GetScheduleTableStatus
        OsIsrXSignalReceiverProvidedApis = GetShutdownHookStackUsage
        OsIsrXSignalReceiverProvidedApis = GetStartupHookStackUsage
        OsIsrXSignalReceiverProvidedApis = GetTaskStackUsage
        OsIsrXSignalReceiverProvidedApis = GetTaskState
        OsIsrXSignalReceiverProvidedApis = HookCallCallback
        OsIsrXSignalReceiverProvidedApis = NextScheduleTable
        OsIsrXSignalReceiverProvidedApis = SetAbsAlarm
        OsIsrXSignalReceiverProvidedApis = SetEvent
        OsIsrXSignalReceiverProvidedApis = SetRelAlarm
        OsIsrXSignalReceiverProvidedApis = StartScheduleTableAbs
        OsIsrXSignalReceiverProvidedApis = StartScheduleTableRel
        OsIsrXSignalReceiverProvidedApis = StopScheduleTable
        OsIsrXSignalReceiverProvidedApis = TerminateApplication
    T1_Controllers (OsTask):
      OsTaskActivation = 1
      OsTaskPriority = 6
      OsTaskSchedule = FULL
      OsTaskStackSharing = false
      OsTaskStackSize = 1024
      OsTaskType = AUTO
      OsTaskAccessingApplication = SystemApplication_OsCore_Core{0..2}
    T1_periodic_9ms (OsAlarm):
      OsAlarmCounterRef = Timer_9ms_Core0
      OsAlarmAccessingApplication = SystemApplication_OsCore_Core{0..2}
      OsAlarmAction
        OsAlarmActivateTask: OsAlarmActivateTaskRef=T1_Controllers
    SystemTimer_1 (OsCounter):
      OsCounterMaxAllowedValue = 2147483647
      OsCounterMinCycle = 1
      OsCounterTicksPerBase = 1
      OsCounterType = HARDWARE
      OsSecondsPerTick = 0.001
      OsCounterAccessingApplication = SystemApplication_OsCore_Core{0..2}
      OsDriver: OsDriverHighResolution=false, OsDriverHardwareTimerChannelRef=GPT_Ch1, OsDriverIsrRef=CounterIsr_SystemTimer_1
    CounterIsr_SystemTimer_1 (OsIsr):
      OsIsrCategory = CATEGORY_2
      OsIsrInterruptType = EXTERNAL
      OsIsrInterruptSource = 1140
      OsIsrInterruptPriority = 1
      OsIsrStackSize = 1024
      OsIsrEnableNesting = false
      OsIsrSpecialFunctionName = Os_TimerPitIsr
    3 x OsCounter, all with OsCounterMaxAllowedValue=1073741823, OsCounterMinCycle=1, OsCounterTicksPerBase=1, OsCounterType=SOFTWARE, OsCounterAccessingApplication=SystemApplication_OsCore_Core0, OsCounterAccessingApplication=SystemApplication_OsCore_Core1, OsCounterAccessingApplication=SystemApplication_OsCore_Core2:
      Timer_3ms_Core0: OsSecondsPerTick=0.003
      Timer_3ms_Core1: OsSecondsPerTick=0.003
      Timer_9ms_Core0: OsSecondsPerTick=0.009
    OS_App0_Core2 (OsApplication):
      OsTrusted = true
      OsTrustedApplicationDelayTimingViolationCall = false
      OsTrustedApplicationWithProtection = false
      OsApplicationIsPrivileged = false
      OsAppUseTrustedFunctionStubs = false
      OsAppMemoryProtectionIdentifier = 2
      OsApplicationCoreRef = EcucCoreDefinition_0
      OsAppCounterRef = SystemTimer_2
      OsAppCounterRef = Timer_3ms_Core2
      OsAppTaskRef = T6_DSP
      OsAppAlarmRef = T6_periodic_9ms
      OsAppCounterRef = Timer_9ms_Core2
      OsApplicationHooks: OsAppErrorHook=false, OsAppShutdownHook=false, OsAppStartupHook=false
    SystemTimer_2 (OsCounter):
      OsCounterMaxAllowedValue = 2147483647
      OsCounterMinCycle = 1
      OsCounterTicksPerBase = 1
      OsCounterType = HARDWARE
      OsSecondsPerTick = 0.001
      OsCounterAccessingApplication = SystemApplication_OsCore_Core{0..2}
      OsDriver: OsDriverHighResolution=false, OsDriverHardwareTimerChannelRef=STM2_Ch0, OsDriverIsrRef=CounterIsr_SystemTimer_2
    CounterIsr_SystemTimer_2 (OsIsr):
      OsIsrCategory = CATEGORY_2
      OsIsrInterruptType = EXTERNAL
      OsIsrInterruptSource = 1184
      OsIsrInterruptPriority = 1
      OsIsrStackSize = 1024
      OsIsrEnableNesting = false
      OsIsrSpecialFunctionName = Os_TimerPfrtIsr
    Timer_3ms_Core2 (OsCounter):
      OsCounterMaxAllowedValue = 1073741823
      OsCounterMinCycle = 1
      OsCounterTicksPerBase = 1
      OsCounterType = SOFTWARE
      OsSecondsPerTick = 0.003
      OsCounterAccessingApplication = SystemApplication_OsCore_Core{0..2}
    3 x OsTask, all with OsTaskActivation=1, OsTaskSchedule=FULL, OsTaskStackSharing=false, OsTaskStackSize=1024, OsTaskType=AUTO, OsTaskAccessingApplication=SystemApplication_OsCore_Core0, OsTaskAccessingApplication=SystemApplication_OsCore_Core1, OsTaskAccessingApplication=SystemApplication_OsCore_Core2:
      T3_AttitudeObserver: OsTaskPriority=10
      T2_EngineController: OsTaskPriority=7
      T6_DSP: OsTaskPriority=11
    3 x OsApplication, all with OsTrusted=true, OsTrustedApplicationDelayTimingViolationCall=false, OsTrustedApplicationWithProtection=false, OsApplicationIsPrivileged=false, OsAppUseTrustedFunctionStubs=false:
      OS_App1_Core0: OsAppMemoryProtectionIdentifier=0, OsAppTaskRef=T3_AttitudeObserver, OsApplicationCoreRef=EcucCoreDefinition_1, OsAppAlarmRef=T3_periodic_9ms
        OsApplicationHooks: OsAppErrorHook=false, OsAppShutdownHook=false, OsAppStartupHook=false
      OS_App1_Core1: OsAppMemoryProtectionIdentifier=1, OsAppTaskRef=T4_HeightObserver, OsApplicationCoreRef=EcucCoreDefinition_2, OsAppAlarmRef=T4_periodic_3ms
        OsApplicationHooks: OsAppErrorHook=false, OsAppShutdownHook=false, OsAppStartupHook=false
      OS_App1_Core2: OsAppMemoryProtectionIdentifier=2, OsAppTaskRef=T5_AltitudeObserver, OsApplicationCoreRef=EcucCoreDefinition_0, OsAppAlarmRef=T5_periodic_3ms
        OsApplicationHooks: OsAppErrorHook=false, OsAppShutdownHook=false, OsAppStartupHook=false
    T5_AltitudeObserver (OsTask):
      OsTaskActivation = 1
      OsTaskPriority = 8
      OsTaskSchedule = FULL
      OsTaskStackSharing = false
      OsTaskStackSize = 1024
      OsTaskType = AUTO
      OsTaskAccessingApplication = SystemApplication_OsCore_Core{0..2}
    T4_HeightObserver (OsTask):
      OsTaskActivation = 1
      OsTaskPriority = 9
      OsTaskSchedule = FULL
      OsTaskStackSharing = false
      OsTaskStackSize = 1024
      OsTaskType = AUTO
      OsTaskAccessingApplication = SystemApplication_OsCore_Core{0..2}
    Timer_9ms_Core2 (OsCounter):
      OsCounterMaxAllowedValue = 1073741823
      OsCounterMinCycle = 1
      OsCounterTicksPerBase = 1
      OsCounterType = SOFTWARE
      OsSecondsPerTick = 0.009
      OsCounterAccessingApplication = SystemApplication_OsCore_Core{0..2}
    5 x OsAlarm, all with OsAlarmAccessingApplication=SystemApplication_OsCore_Core0, OsAlarmAccessingApplication=SystemApplication_OsCore_Core1, OsAlarmAccessingApplication=SystemApplication_OsCore_Core2:
      T5_periodic_3ms: OsAlarmCounterRef=Timer_3ms_Core2
        OsAlarmAction
          OsAlarmActivateTask: OsAlarmActivateTaskRef=T5_AltitudeObserver
      T4_periodic_3ms: OsAlarmCounterRef=Timer_3ms_Core1
        OsAlarmAction
          OsAlarmActivateTask: OsAlarmActivateTaskRef=T4_HeightObserver
      T3_periodic_9ms: OsAlarmCounterRef=Timer_9ms_Core0
        OsAlarmAction
          OsAlarmActivateTask: OsAlarmActivateTaskRef=T3_AttitudeObserver
      T2_periodic_9ms: OsAlarmCounterRef=Timer_9ms_Core1
        OsAlarmAction
          OsAlarmActivateTask: OsAlarmActivateTaskRef=T2_EngineController
      T6_periodic_9ms: OsAlarmCounterRef=Timer_9ms_Core2
        OsAlarmAction
          OsAlarmActivateTask: OsAlarmActivateTaskRef=T6_DSP
    Timer_9ms_Core1 (OsCounter):
      OsCounterMaxAllowedValue = 1073741823
      OsCounterMinCycle = 1
      OsCounterTicksPerBase = 1
      OsCounterType = SOFTWARE
      OsSecondsPerTick = 0.009
      OsCounterAccessingApplication = SystemApplication_OsCore_Core{0..2}
