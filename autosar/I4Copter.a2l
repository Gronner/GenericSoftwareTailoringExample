/begin MODULE I4Copter ""
/begin MOD_PAR "" /* Comment */ NO_OF_INTERFACES 0 /end MOD_PAR
/begin MOD_COMMON "" ALIGNMENT_BYTE 1 ALIGNMENT_WORD 2 ALIGNMENT_LONG 2 ALIGNMENT_FLOAT32_IEEE 2 ALIGNMENT_FLOAT64_IEEE 4 BYTE_ORDER MSB_LAST DEPOSIT ABSOLUTE /end MOD_COMMON
/begin CHARACTERISTIC VI_Gain_Value "" VALUE /* Type */ 0x0000 /* Address */ FLOAT32_IEEE_COL_DIRECT /* Deposit */ 0 /* MaxDiff */ VOID_SCALING -3.402e38 3.402e38 /end CHARACTERISTIC
/begin CHARACTERISTIC x_axis__VI_Gain "" VAL_BLK /* Type */ 0x0000 /* Address */ FLOAT32_IEEE_COL_DIRECT /* Deposit */ 0 /* MaxDiff */ VOID_SCALING -3.402e38 3.402e38 NUMBER 3 /end CHARACTERISTIC
/begin MEASUREMENT x_axis__VI_Integrator "" FLOAT32_IEEE /* Datatype */ VOID_SCALING 1 /* Resolution */ 100 /* Accuracy */ -3.402e38 3.402e38 ECU_ADDRESS 0x0000 /end MEASUREMENT
/begin COMPU_METHOD VOID_SCALING "Void scaling for unscaled variables" RAT_FUNC /* ConversionType */ "%12.6" /* Format */ "" /* Unit */ COEFFS 0 1 0 0 0 1 /end COMPU_METHOD
/begin FUNCTION STEP_AttitudeObserver "" /begin DEF_CHARACTERISTIC x_axis__VI_Gain /end DEF_CHARACTERISTIC /begin LOC_MEASUREMENT x_axis__VI_Integrator /end LOC_MEASUREMENT /end FUNCTION
/begin FUNCTION STEP_HeightObserver "" /begin DEF_CHARACTERISTIC VI_Gain_Value /end DEF_CHARACTERISTIC /end FUNCTION
/begin RECORD_LAYOUT FLOAT32_IEEE_COL_DIRECT FNC_VALUES 1 FLOAT32_IEEE COLUMN_DIR DIRECT /end RECORD_LAYOUT
/end MODULE
