AUTOSAR XML (schema 4.0)
package /I4Copter
  module config EcuC
    Processor (EcucHardware)
      3 x EcucCoreDefinition:
        EcucCoreDefinition_{0..2}: EcucCoreId={0..2}
  module config Os
    appmode1 (OsAppMode)
    OsOS: OsStatus=EXTENDED, OsUseGetServiceId=false, OsUseParameterAccess=false, OsUseResScheduler=false
      OsHooks: OsErrorHook=false, OsShutdownHook=false, OsStartupHook=false, OsPreTaskHook=false, OsPostTaskHook=false
    3 x OsCore:
      Processor_Core{0..2}: OsCoreEcucCoreRef=EcucCoreDefinition_{0..2}
    6 x OsTask, all with OsTaskActivation=1, OsTaskPriority=1, OsTaskSchedule=FULL:
      T1_Controllers
        OsTaskAutostart: OsTaskAppModeRef=OS_APPMODE_ANY
      T3_AttitudeObserver
        OsTaskAutostart: OsTaskAppModeRef=OS_APPMODE_ANY
      T2_EngineController
        OsTaskAutostart: OsTaskAppModeRef=OS_APPMODE_ANY
      T4_HeightObserver
        OsTaskAutostart: OsTaskAppModeRef=OS_APPMODE_ANY
      T6_DSP
        OsTaskAutostart: OsTaskAppModeRef=OS_APPMODE_ANY
      T5_AltitudeObserver
        OsTaskAutostart: OsTaskAppModeRef=OS_APPMODE_ANY
    6 x OsApplication:
      OS_Application_0: OsAppTaskRef=T1_Controllers, OsApplicationCoreRef=EcucCoreDefinition_1
        OsApplicationHooks: OsAppErrorHook=false, OsAppShutdownHook=false, OsAppStartupHook=false
      OS_Application_1: OsAppTaskRef=T3_AttitudeObserver, OsApplicationCoreRef=EcucCoreDefinition_2
        OsApplicationHooks: OsAppErrorHook=false, OsAppShutdownHook=false, OsAppStartupHook=false
      OS_Application_2: OsAppTaskRef=T2_EngineController, OsApplicationCoreRef=EcucCoreDefinition_1
        OsApplicationHooks: OsAppErrorHook=false, OsAppShutdownHook=false, OsAppStartupHook=false
      OS_Application_3: OsAppTaskRef=T4_HeightObserver, OsApplicationCoreRef=EcucCoreDefinition_1
        OsApplicationHooks: OsAppErrorHook=false, OsAppShutdownHook=false, OsAppStartupHook=false
      OS_Application_4: OsAppTaskRef=T6_DSP, OsApplicationCoreRef=EcucCoreDefinition_0
        OsApplicationHooks: OsAppErrorHook=false, OsAppShutdownHook=false, OsAppStartupHook=false
      OS_Application_5: OsAppTaskRef=T5_AltitudeObserver, OsApplicationCoreRef=EcucCoreDefinition_0
        OsApplicationHooks: OsAppErrorHook=false, OsAppShutdownHook=false, OsAppStartupHook=false
